// Copied from ~/repos/riscv-veryl/src/ddr3_ctrl.veryl (commit 78e2537, 2026-09-10) for the NVMe DDR3 namespace.
// Keep in sync with the RISC-V project; local changes should be upstreamed there.
// DDR3 SDRAM controller (single x16 device, BL8, closed-page, DLL-off).
//
// Sits between the CPU-side 128-bit line bus (`LineBusIf` slave; one
// line = one BL8 burst of the x16 device) and a thin DDR3 PHY. Everything the PHY needs to know is
// expressed as *slot vectors* in the memory-side clock domain, so the same
// controller drives either the Gowin GW2A IOLOGIC wrapper on the Tang
// Primer 20K (`Ddr3PhyGw2a`) or the behavioural DRAM model used under
// the simulator (`sim/ddr3/ddr3_model.sv`). See doc/ddr3_controller.md.
//
// Clocking
// --------
//   i_clk_cpu : CPU / bus clock. `bus` and `ctl` live here.
//   i_clk_mem : "pclk" = DDR3 CK / 2. The command FSM, the write pattern
//               generator and the read capture run here. One DDR3 CK is
//               4 *slots* (fclk = 2 x CK, DDR), so one pclk cycle is 8 slots.
//   Requests cross the domains with a toggle + 2-FF synchroniser in each
//   direction. At most one DRAM transaction is in flight (`ready` stays
//   low until it completes, so posted writes and the reads behind them
//   are processed strictly in order); the payload registers are stable
//   while the toggle propagates. Partial writes use the DM pins (no
//   read-modify-write).
//
// PHY-side slot-vector interface (pclk domain, one pclk = 8 slots)
// ----------------------------------------------------------------
//   Commands are SDR and are only ever issued in the first CK of a pclk
//   cycle: the PHY drives {cs_n, ras_n, cas_n, we_n, ba, a} for CK 0 and
//   DESELECT for CK 1. CK itself is generated by the PHY as slots
//   {0,0,1,1,0,0,1,1} (rising edges at the start of slots 2 and 6), so
//   the command changes 2 slots (half a CK) before the CK edge samples it.
//   o_dq_out[16*s +: 16]  DQ value driven during slot s
//   o_dq_oe[s/2]          DQ output enable for slots 2i, 2i+1
//   o_dm_out[2*s +: 2]    {UDM, LDM} during slot s
//   o_dqs_out[2*s +: 2]   {DQSU, DQSL} during slot s (DQS# = inverse)
//   o_dqs_oe[s/2]         DQS output enable
//   i_dq_in[16*s +: 16]   DQ sampled at slot s (IDES8 / model output)
//   i_dqs_in[2*s +: 2]    DQS sampled at slot s (for calibration only)
//
// Write timing (WR at pclk N, CK 0, CWL = 6): first DQS rising edge is
// 6 CK = 24 slots after the CK edge that sampled WR (slot 2 of N), i.e.
// slot 2 of N+3. DQS preamble is driven low from slot 6 of N+2, the eight
// data beats are centred on the DQS edges (beat b occupies slots
// 2b+1 .. 2b+2 counted from N+3 slot 0), and the postamble occupies
// slots 0..1 of N+5.
//
// Read timing (RD at pclk N, CL = 6): the DRAM drives beat 0 from slot 2
// of N+3 (+ tDQSCK + flight time). We do not use DQS for capture: the
// PHY samples DQ (and DQS) at every slot, the controller keeps a 64-slot
// history per DQ bit and picks the eight beats at slot RD_SEL + 2b of
// the history `RD_LAT` pclk cycles after the command.
//
// Read auto-calibration (CAL_ENABLE): right after ZQCL, before init_done,
// the controller writes a fixed 8-beat pattern to the line at CAL_ADDR
// (default: the last line of the device), reads it back, freezes the
// sample history and scans every RD_SEL candidate for an exact match of
// all 128 bits; RD_SEL becomes the middle of the matching run. If nothing
// matches, RD_LAT is stepped from CAL_LAT_MIN to CAL_LAT_MAX and the read
// repeated; if that fails too STATUS.cal_fail is set and the defaults
// stay. Software can still override both through RD_CAL (a write sets
// the override, the register reads back the values in use), and the DQS
// history is exposed for manual sweeps on the board.
//
// Control registers (`ctl`, byte offsets, CPU domain)
// ---------------------------------------------------
//   0x00 STATUS  RO  bit 0 = init done (DRAM initialised, refresh running)
//                    bit 1 = auto-calibration found a working RD_SEL
//                    bit 2 = auto-calibration failed (defaults in use)
//   0x04 RD_CAL  RW  [5:0] RD_SEL (history slot of beat 0, used for the
//                    even beats 0,2,4,6 at RD_SEL + 2b), [11:8] RD_LAT
//                    (pclk cycles from RD to the history snapshot),
//                    [21:16] RD_SEL_ODD (slot of beat 1; odd beats
//                    1,3,5,7 at RD_SEL_ODD + 2(b-1)). Even and odd beats
//                    are calibrated separately so a duty-cycle asymmetry
//                    of the sampling (rising/falling fclk edge) does not
//                    push the odd beats onto the previous beat. Reads
//                    return the values in use (auto-calibrated unless
//                    written); a write overrides all until reset.
//   0x28 RECAL   RW  bit 0 = periodic re-calibration enable (default
//                    RECAL_ENABLE). Every 2^RECAL_REF_SHIFT refreshes the
//                    controller repeats the pattern write / read / scan on
//                    the scratch line and, if the scan matches, moves
//                    RD_SEL / RD_SEL_ODD; a miss keeps the old values.
//                    The scratch line must then be kept away from software
//                    (reserve the last 4 KiB in the device tree).
//   0x2C RECAL_COUNT RO number of successful re-calibrations
//   0x30 RECAL_FAIL  RO number of re-calibrations that found nothing
//   0x34 RECAL_RANGE RO {2'b0, sel_odd_max, 2'b0, sel_odd_min,
//                        2'b0, sel_max, 2'b0, sel_min}: the range the
//                    calibrated slots have covered since init (drift)
//   0x08/0x0C    RO  DQSL history (lo/hi 32 slots) at the last snapshot
//   0x10/0x14    RO  DQSU history
//   0x18/0x1C    RO  DQ[0] history
//   0x20/0x24    RO  DQ[8] history
//   Histories: bit i = slot i, i = 0 is the oldest of the 64 slots.
//
// Address map inside the device (byte address `addr`, 128 MiB):
//   col  = {addr[COL_BITS:4], 3'b000}         (BL8 aligned)
//   bank = addr[COL_BITS+1 +: BANK_BITS]
//   row  = addr[COL_BITS+1+BANK_BITS +: ROW_BITS]
module Ddr3Ctrl #(
    // pclk period in ps (pclk = CK / 2). 13333 ps = 75 MHz pclk = 150 MHz
    // CK = 300 MT/s.
    parameter int unsigned PCLK_PS = 13333,
    // Device geometry (H5TQ1G63EFR / MT41K64M16: 1 Gbit x16).
    parameter int unsigned ROW_BITS  = 13,
    parameter int unsigned COL_BITS  = 10,
    parameter int unsigned BANK_BITS = 3 ,
    // DDR3 timing (ps unless noted). Conservative DDR3-1600 1 Gb values;
    // tRFC defaults to the 2 Gb figure so a bigger part also works.
    parameter int unsigned T_RESET_PS = 200_000_000, // RESET# low after power up (200 us)
    parameter int unsigned T_CKE_PS   = 500_000_000, // CKE low after RESET# high (500 us)
    parameter int unsigned T_XPR_PS   = 170_000    , // CKE high -> first MRS (tRFC + 10 ns)
    parameter int unsigned T_RCD_PS   = 13_750     ,
    parameter int unsigned T_RP_PS    = 13_750     ,
    parameter int unsigned T_WR_PS    = 15_000     ,
    parameter int unsigned T_RFC_PS   = 160_000    ,
    parameter int unsigned T_REFI_PS  = 7_800_000  ,
    // Read capture defaults (see header), used when CAL_ENABLE = 0 or the
    // calibration fails. With the snapshot RD_LAT = 9 cycles after the RD
    // command (the extraction is registered once, so the snapshot sees the
    // history one pclk old) the sim model's samples put beat 0 at history
    // slots 42..43; the real PHY has a different IDES8 latency, which is
    // what the auto-calibration absorbs.
    parameter int unsigned RD_SEL_DEFAULT = 42,
    parameter int unsigned RD_LAT_DEFAULT = 9 ,
    // Read auto-calibration at init (see header). CAL_ADDR is the byte
    // offset of the scratch line (its 16 bytes are overwritten).
    parameter bit            CAL_ENABLE = 1            ,
    parameter logic [32-1:0] CAL_ADDR   = 32'h07FF_FFF0,
    // The scan only looks at windows that start at or after the RD
    // command (RD_LAT >= 8): the PHY input also sees the controller's own
    // pattern write, and with the IOLOGIC round trip that echo would
    // otherwise be found first. The read is also issued a few cycles later
    // than a normal one so the echo has left the history.
    parameter int unsigned CAL_LAT_MIN = 8 ,
    parameter int unsigned CAL_LAT_MAX = 15,
    // Periodic re-calibration (see the register map). Off by default: it
    // overwrites the scratch line at run time.
    parameter bit          RECAL_ENABLE    = 0 ,
    parameter int unsigned RECAL_REF_SHIFT = 16 // every 2^16 refreshes ~ 0.5 s
) (
    input var logic i_clk_cpu,
    input var logic i_rst_cpu,
    input var logic i_clk_mem,
    input var logic i_rst_mem,

    // CPU side
    LineBusIf.slave bus, // 16-byte line requests
    BusIf.slave     ctl, // control / calibration registers

    // PHY side (pclk domain)
    output var logic           o_reset_n,
    output var logic           o_cke    ,
    output var logic           o_odt    ,
    output var logic           o_cs_n   ,
    output var logic           o_ras_n  ,
    output var logic           o_cas_n  ,
    output var logic           o_we_n   ,
    output var logic [3-1:0]   o_ba     ,
    output var logic [14-1:0]  o_a      ,
    output var logic [128-1:0] o_dq_out ,
    output var logic [4-1:0]   o_dq_oe  ,
    output var logic [16-1:0]  o_dm_out ,
    output var logic [16-1:0]  o_dqs_out,
    output var logic [4-1:0]   o_dqs_oe ,
    input  var logic [128-1:0] i_dq_in  ,
    input  var logic [16-1:0]  i_dqs_in ,

    output var logic o_init_done
);
    // ------------------------------------------------------------------
    // Derived timing (pclk cycles, rounded up)
    // ------------------------------------------------------------------
    localparam int unsigned CK_PS    = PCLK_PS / 2;
    localparam int unsigned C_RESET  = (T_RESET_PS + PCLK_PS - 1) / PCLK_PS;
    localparam int unsigned C_CKE    = (T_CKE_PS + PCLK_PS - 1) / PCLK_PS;
    localparam int unsigned C_XPR    = (T_XPR_PS + PCLK_PS - 1) / PCLK_PS;
    localparam int unsigned C_MRD    = 2; // tMRD = 4 CK
    localparam int unsigned C_MOD    = 6; // tMOD = max(12 CK, 15 ns) -> 12 CK
    localparam int unsigned C_ZQINIT = 256; // tZQinit = 512 CK
    localparam int unsigned C_RCD    = (T_RCD_PS + PCLK_PS - 1) / PCLK_PS;
    // WR -> next ACT: WL (6 CK) + BL8 (4 CK) + tWR + tRP (auto precharge).
    localparam int unsigned C_WR_BUSY = (10 * CK_PS + T_WR_PS + T_RP_PS + PCLK_PS - 1) / PCLK_PS;
    // RD -> next ACT: tRTP (4 CK) + tRP; the read also waits RD_LAT for
    // its data, whichever is longer.
    localparam int unsigned C_RD_BUSY = (4 * CK_PS + T_RP_PS + PCLK_PS - 1) / PCLK_PS;
    localparam int unsigned C_RFC     = (T_RFC_PS + PCLK_PS - 1) / PCLK_PS;
    localparam int unsigned C_REFI    = T_REFI_PS / PCLK_PS;

    // Mode registers (DLL off, CL = 6, CWL = 6, BL8, WR = 6, no ODT).
    localparam logic [14-1:0] MR0 = 14'h0420; // WR=6 (A11:9=010), CL=6 (A6:4=010,A2=0), BL8
    localparam logic [14-1:0] MR1 = 14'h0001; // DLL disable, RZQ/6, RTT_NOM off, AL=0
    localparam logic [14-1:0] MR2 = 14'h0008; // CWL=6 (A5:3=001), RTT_WR off
    localparam logic [14-1:0] MR3 = 14'h0000;

    // {cs_n, ras_n, cas_n, we_n}
    localparam logic [4-1:0] CMD_MRS  = 4'b0000;
    localparam logic [4-1:0] CMD_REF  = 4'b0001;
    localparam logic [4-1:0] CMD_ACT  = 4'b0011;
    localparam logic [4-1:0] CMD_WR   = 4'b0100;
    localparam logic [4-1:0] CMD_RD   = 4'b0101;
    localparam logic [4-1:0] CMD_ZQCL = 4'b0110;
    localparam logic [4-1:0] CMD_DES  = 4'b1111;

    // ------------------------------------------------------------------
    // CPU domain: request capture, control registers
    // ------------------------------------------------------------------
    logic           req_tog   ; // toggles per request (cpu -> mem)
    logic           done_tog_m; // toggles per completion (mem -> cpu)
    logic           done_s1   ;
    logic           done_s2   ;
    logic           done_s3   ;
    logic [32-1:0]  req_addr  ;
    logic           req_we    ;
    logic [16-1:0]  req_wstrb ;
    logic [128-1:0] req_wdata ;
    logic [128-1:0] rsp_data  ; // written by mem domain before done toggles

    logic init_done_m ;
    logic init_done_s1;
    logic init_done_s2;
    logic cal_ok_m    ;
    logic cal_fail_m  ;
    logic cal_ok_s1   ;
    logic cal_ok_s2   ;
    logic cal_fail_s1 ;
    logic cal_fail_s2 ;

    logic busy; always_comb busy = req_tog != done_s2;
    logic done; always_comb done = done_s2 != done_s3; // one-cycle completion pulse

    logic engine_idle; always_comb engine_idle = !busy && init_done_s2;
    logic grant      ; always_comb grant       = bus.valid && engine_idle;

    always_comb bus.ready = engine_idle;

    logic           rvalid_q;
    logic [128-1:0] rdata_q ;

    always_comb bus.rvalid = rvalid_q;
    always_comb bus.rdata  = rdata_q;

    always_ff @ (posedge i_clk_cpu) begin
        if (i_rst_cpu) begin
            req_tog      <= 1'b0;
            done_s1      <= 1'b0;
            done_s2      <= 1'b0;
            done_s3      <= 1'b0;
            init_done_s1 <= 1'b0;
            init_done_s2 <= 1'b0;
            cal_ok_s1    <= 1'b0;
            cal_ok_s2    <= 1'b0;
            cal_fail_s1  <= 1'b0;
            cal_fail_s2  <= 1'b0;
            req_addr     <= 32'b0;
            req_we       <= 1'b0;
            req_wstrb    <= 16'b0;
            req_wdata    <= 128'b0;
            rvalid_q     <= 1'b0;
            rdata_q      <= 128'b0;
        end else begin
            done_s1      <= done_tog_m;
            done_s2      <= done_s1;
            done_s3      <= done_s2;
            init_done_s1 <= init_done_m;
            init_done_s2 <= init_done_s1;
            cal_ok_s1    <= cal_ok_m;
            cal_ok_s2    <= cal_ok_s1;
            cal_fail_s1  <= cal_fail_m;
            cal_fail_s2  <= cal_fail_s1;

            rvalid_q <= 1'b0;

            if (grant) begin
                req_addr  <= bus.addr;
                req_we    <= bus.we;
                req_wstrb <= bus.wstrb;
                req_wdata <= bus.wdata;
                req_tog   <= ~req_tog;
            end

            if (done && !req_we) begin
                rvalid_q <= 1'b1;
                rdata_q  <= rsp_data;
            end
        end
    end

    logic [6-1:0]  rd_sel       ;
    logic [6-1:0]  rd_sel_odd   ;
    logic [4-1:0]  rd_lat       ;
    logic          rd_sw        ; // RD_CAL written by software: overrides the calibration
    logic          recal_en     ;
    logic [32-1:0] recal_count_c; // copies from the memory domain (diagnostic)
    logic [32-1:0] recal_fail_c ;
    logic [32-1:0] recal_range_c;
    logic [6-1:0]  sel_eff      ; // values in use (from the memory domain, quasi-static)
    logic [6-1:0]  sel_odd_eff  ;
    logic [4-1:0]  lat_eff      ;
    logic          ctl_rvalid   ;
    logic [32-1:0] ctl_rdata    ;
    logic [64-1:0] dbg_dqsl     ; // mem domain, quasi-static when read
    logic [64-1:0] dbg_dqsu     ;
    logic [64-1:0] dbg_dq0      ;
    logic [64-1:0] dbg_dq8      ;

    always_comb ctl.ready  = 1'b1;
    always_comb ctl.rvalid = ctl_rvalid;
    always_comb ctl.rdata  = ctl_rdata;

    always_ff @ (posedge i_clk_cpu) begin
        if (i_rst_cpu) begin
            rd_sel     <= RD_SEL_DEFAULT[5:0];
            rd_sel_odd <= RD_SEL_DEFAULT[5:0] + 6'd2;
            rd_lat     <= RD_LAT_DEFAULT[3:0];
            rd_sw      <= 1'b0;
            recal_en   <= RECAL_ENABLE;
            ctl_rvalid <= 1'b0;
            ctl_rdata  <= 32'b0;
        end else begin
            ctl_rvalid <= ctl.valid && !ctl.we;
            if (ctl.valid && ctl.we && ctl.addr[5:2] == 4'd1) begin
                // A partial write keeps the other field at its current
                // effective value.
                rd_sel     <= sel_eff;
                rd_sel_odd <= sel_odd_eff;
                rd_lat     <= lat_eff;
                if (ctl.wstrb[0]) begin
                    rd_sel <= ctl.wdata[5:0];
                end
                if (ctl.wstrb[1]) begin
                    rd_lat <= ctl.wdata[11:8];
                end
                if (ctl.wstrb[2]) begin
                    rd_sel_odd <= ctl.wdata[21:16];
                end
                rd_sw <= 1'b1;
            end
            if (ctl.valid && ctl.we && ctl.addr[5:2] == 4'd10 && ctl.wstrb[0]) begin
                recal_en <= ctl.wdata[0];
            end
            ctl_rdata <= (((ctl.addr[5:2]) ==? (4'd0)) ? (
                {29'b0, cal_fail_s2, cal_ok_s2, init_done_s2}
            ) : ((ctl.addr[5:2]) ==? (4'd1)) ? (
                {10'b0, sel_odd_eff, 4'b0, lat_eff, 2'b0, sel_eff}
            ) : ((ctl.addr[5:2]) ==? (4'd2)) ? (
                dbg_dqsl[31:0]
            ) : ((ctl.addr[5:2]) ==? (4'd3)) ? (
                dbg_dqsl[63:32]
            ) : ((ctl.addr[5:2]) ==? (4'd4)) ? (
                dbg_dqsu[31:0]
            ) : ((ctl.addr[5:2]) ==? (4'd5)) ? (
                dbg_dqsu[63:32]
            ) : ((ctl.addr[5:2]) ==? (4'd6)) ? (
                dbg_dq0[31:0]
            ) : ((ctl.addr[5:2]) ==? (4'd7)) ? (
                dbg_dq0[63:32]
            ) : ((ctl.addr[5:2]) ==? (4'd8)) ? (
                dbg_dq8[31:0]
            ) : ((ctl.addr[5:2]) ==? (4'd9)) ? (
                dbg_dq8[63:32]
            ) : ((ctl.addr[5:2]) ==? (4'd10)) ? (
                {31'b0, recal_en}
            ) : ((ctl.addr[5:2]) ==? (4'd11)) ? (
                recal_count_c
            ) : ((ctl.addr[5:2]) ==? (4'd12)) ? (
                recal_fail_c
            ) : ((ctl.addr[5:2]) ==? (4'd13)) ? (
                recal_range_c
            ) : (
                32'b0
            ));
        end
    end

    logic [32-1:0]  req_addr_m    ;
    logic           req_we_m      ;
    logic [16-1:0]  req_wstrb_m   ;
    logic [128-1:0] req_wdata_m   ;
    logic [6-1:0]   rd_sel_m      ;
    logic [6-1:0]   rd_sel_odd_m  ;
    logic [6-1:0]   sel_odd_used  ;
    logic [6-1:0]   sel_odd_used_q;
    logic [4-1:0]   rd_lat_m      ;
    logic           rd_sw_m       ;
    logic           recal_en_m    ;
    logic [32-1:0]  recal_count   ;
    logic [32-1:0]  recal_fail    ;
    logic [6-1:0]   sel_min       ;
    logic [6-1:0]   sel_max       ;
    logic [6-1:0]   sel_odd_min   ;
    logic [6-1:0]   sel_odd_max   ;
    logic [6-1:0]   sel_used      ;
    logic [6-1:0]   sel_used_q    ; // registered copy feeding the history mux
    logic [4-1:0]   lat_used      ;

    always_comb rd_sw_m       = rd_sw;
    always_comb recal_en_m    = recal_en;
    always_comb recal_count_c = recal_count;
    always_comb recal_fail_c  = recal_fail;
    always_comb recal_range_c = {2'b0, sel_odd_max, 2'b0, sel_odd_min, 2'b0, sel_max, 2'b0, sel_min};
    always_comb sel_eff       = sel_used;
    always_comb sel_odd_eff   = sel_odd_used;
    always_comb lat_eff       = lat_used;
    always_comb req_addr_m    = req_addr;
    always_comb req_we_m      = req_we;
    always_comb req_wstrb_m   = req_wstrb;
    always_comb req_wdata_m   = req_wdata;
    always_comb rd_sel_m      = rd_sel;
    always_comb rd_sel_odd_m  = rd_sel_odd;
    always_comb rd_lat_m      = rd_lat;

    typedef enum logic [4-1:0] {
        State_RESET,
        State_CKE,
        State_XPR,
        State_MR3,
        State_MR1,
        State_MR0,
        State_ZQ,
        State_CAL_START,
        State_IDLE,
        State_RW,
        State_RD_WAIT,
        State_WR_WAIT
    } State;

    State          state       ;
    logic [32-1:0] timer       ;
    logic [32-1:0] ref_cnt     ;
    logic          ref_due     ;
    logic [32-1:0] ref_total   ; // refreshes issued (re-calibration period)
    logic          recal_due   ;
    logic          recal_active; // the running calibration is a periodic one
    localparam logic [32-1:0] RECAL_MASK   = (32'd1 << RECAL_REF_SHIFT) - 1;
    logic          req_s1      ;
    logic          req_s2      ;
    logic          req_s3      ; // third stage: the payload copies (unconstrained
    // cross-domain paths) get one more pclk to settle
    // before the FSM issues ACT from them
    logic [4-1:0] cmd    ;
    logic [3-1:0] wr_cnt ;
    logic [4-1:0] rd_cnt ;
    logic         rd_pend;

    // ---- read auto-calibration ----
    logic         cal_active  ; // the current ACT/RW/wait sequence is a calibration access
    logic         cal_we      ; // calibration access is the pattern write
    logic [6-1:0] cal_sel     ; // result (defaults until calibrated)
    logic [6-1:0] cal_sel_odd ;
    logic [4-1:0] cal_lat     ;
    logic         cal_eval    ; // history frozen, scanning candidates
    logic [6-1:0] scan_sel    ;
    logic [6-1:0] scan_first  ;
    logic [6-1:0] scan_last   ;
    logic         scan_found  ;
    logic [6-1:0] scan_first_o;
    logic [6-1:0] scan_last_o ;
    logic         scan_found_o;
    logic         scan_done   ;

    // Pattern: beat b = 0x5A3C ^ {b, b, b, b} (all 16 DQ bits exercised).
    function automatic logic [16-1:0] cal_beat(
        input var logic [4-1:0] b
    ) ;
        return 16'h5A3C ^ {4{b}};
    endfunction

    // Effective capture setting: scanning during calibration, otherwise
    // the software override or the calibration result.
    always_comb begin
        if (cal_eval) begin
            sel_used     = scan_sel;
            sel_odd_used = scan_sel;
        end else if (rd_sw_m) begin
            sel_used     = rd_sel_m;
            sel_odd_used = rd_sel_odd_m;
        end else begin
            sel_used     = cal_sel;
            sel_odd_used = cal_sel_odd;
        end
        lat_used = ((rd_sw_m) ? ( rd_lat_m ) : ( cal_lat ));
    end

    logic pending; always_comb pending = req_s3 != done_tog_m;

    // Column / bank / row from the byte address. COL_BITS is 10 for every
    // supported part; the row is taken 14 bits wide (A13 is 0 for a 1 Gb
    // device because the address never reaches bit 27).
    logic [32-1:0]        addr_used; always_comb addr_used = ((cal_active) ? ( CAL_ADDR ) : ( req_addr_m ));
    logic [10-1:0]        col      ; always_comb col       = {addr_used[10:4], 3'b000};
    logic [BANK_BITS-1:0] bank     ; always_comb bank      = addr_used[COL_BITS + 1+:BANK_BITS];
    logic [14-1:0]        row      ; always_comb row       = addr_used[COL_BITS + 1 + BANK_BITS+:14];
    logic                 we_used  ; always_comb we_used   = ((cal_active) ? ( cal_we ) : ( req_we_m ));

    always_comb o_cs_n      = cmd[3];
    always_comb o_ras_n     = cmd[2];
    always_comb o_cas_n     = cmd[1];
    always_comb o_we_n      = cmd[0];
    always_comb o_odt       = 1'b0;
    always_comb o_init_done = init_done_m;

    // Scan pipeline valid flags (assigned with the pipeline below).
    logic scan_valid_q ;
    logic scan_valid_q2;
    logic scan_valid_q3;

    // The calibration freezes the history from the same edge a normal
    // read would take its snapshot, so the scan sees exactly what a read
    // with the chosen RD_LAT sees.
    // (The extraction below is registered once more, so a read at RD_LAT
    // sees the history as it was one cycle earlier; the freeze starts one
    // cycle before the snapshot for the same reason.)
    logic hist_hold; always_comb hist_hold = cal_eval || scan_valid_q || scan_valid_q2 || scan_valid_q3
        || (cal_active && rd_pend && ((rd_cnt + 1 == lat_used) || (rd_cnt == lat_used)));

    // Sample history: bit index = slot, 0 oldest. New samples enter at
    // the top so index i of a DQ bit is slot (i % 8) of pclk (i / 8)
    // counted from 8 cycles ago.
    logic [64-1:0] hist_dq  [16];
    logic [64-1:0] hist_dqs [2] ;

    always_ff @ (posedge i_clk_mem) begin
        if (i_rst_mem) begin
            for (int i = 0; i < 16; i++) begin
                hist_dq[i] <= 64'b0;
            end
            hist_dqs[0] <= 64'b0;
            hist_dqs[1] <= 64'b0;
        end else if (!hist_hold) begin
            for (int i = 0; i < 16; i++) begin
                for (int s = 0; s < 8; s++) begin
                    hist_dq[i][56 + s] <= i_dq_in[16 * s + i];
                end
                hist_dq[i][55:0] <= hist_dq[i][63:8];
            end
            for (int s = 0; s < 8; s++) begin
                hist_dqs[0][56 + s] <= i_dqs_in[2 * s];
                hist_dqs[1][56 + s] <= i_dqs_in[2 * s + 1];
            end
            hist_dqs[0][55:0] <= hist_dqs[0][63:8];
            hist_dqs[1][55:0] <= hist_dqs[1][63:8];
        end
    end

    logic [24-1:0] win_q          [16];
    logic [24-1:0] win_odd_q      [16];
    logic [3-1:0]  sel_fine_q         ;
    logic [3-1:0]  sel_odd_fine_q     ;
    always_ff @ (posedge i_clk_mem) begin
        for (int i = 0; i < 16; i++) begin
            win_q[i]     <= hist_dq[i][sel_used_q[5:3] * 8+:24];
            win_odd_q[i] <= hist_dq[i][sel_odd_used_q[5:3] * 8+:24];
        end
        sel_fine_q     <= sel_used_q[2:0];
        sel_odd_fine_q <= sel_odd_used_q[2:0];
    end
    logic [16-1:0] rd_beats [8];
    always_comb begin
        for (int i = 0; i < 16; i++) begin
            for (int b = 0; b < 8; b++) begin
                logic [5-1:0] idx;
                if (b[0]) begin
                    idx            = {2'b0, sel_odd_fine_q} + (b[4:0] - 1) * 2;
                    rd_beats[b][i] = win_odd_q[i][idx];
                end else begin
                    idx            = {2'b0, sel_fine_q} + b[4:0] * 2;
                    rd_beats[b][i] = win_q[i][idx];
                end
            end
        end
    end

    // Write data beats: beat b carries bytes 2b, 2b+1 of the line; DM
    // masks every byte whose strobe is clear.
    logic [16-1:0] wr_beat [8];
    logic [2-1:0]  wr_mask [8];
    always_comb begin
        for (int b = 0; b < 8; b++) begin
            if (cal_active) begin
                wr_beat[b] = cal_beat(b[3:0]);
                wr_mask[b] = 2'b00;
            end else begin
                wr_beat[b] = req_wdata_m[b * 16+:16];
                wr_mask[b] = ~req_wstrb_m[b * 2+:2];
            end
        end
    end

    // Slot layouts for the data cycles (see header): beat b of a data
    // cycle sits in slots 2b+1, 2b+2; slot 0 carries the tail of the
    // previous cycle's last beat.
    function automatic logic [128-1:0] data_slots(
        input var logic [16-1:0] b0  ,
        input var logic [16-1:0] b1  ,
        input var logic [16-1:0] b2  ,
        input var logic [16-1:0] b3  ,
        input var logic [16-1:0] tail
    ) ;
        return {b3, b2, b2, b1, b1, b0, b0, tail};
    endfunction
    function automatic logic [16-1:0] mask_slots(
        input var logic [2-1:0] m0  ,
        input var logic [2-1:0] m1  ,
        input var logic [2-1:0] m2  ,
        input var logic [2-1:0] m3  ,
        input var logic [2-1:0] tail
    ) ;
        return {m3, m2, m2, m1, m1, m0, m0, tail};
    endfunction

    // Centre of the matching run (7-bit sum so 42 + 43 does not wrap).
    logic [7-1:0] scan_sum  ; always_comb scan_sum   = {1'b0, scan_first} + {1'b0, scan_last};
    logic [7-1:0] scan_sum_o; always_comb scan_sum_o = {1'b0, scan_first_o} + {1'b0, scan_last_o};

    // The scan is pipelined: the beats extracted for scan_sel are
    // registered and compared one cycle later (keeps the history mux and
    // the 128-bit compare out of the same pclk cycle).
    // Three register stages: sel_used -> sel_used_q -> win_q -> rd_beats
    // -> rd_beats_q -> compare, so scan_sel is delayed three times.
    logic [16-1:0] rd_beats_q   [8];
    logic [6-1:0]  scan_sel_q      ;
    logic [6-1:0]  scan_sel_q2     ;
    logic [6-1:0]  scan_sel_q3     ;
    logic          scan_match      ; // even beats match at the candidate
    logic          scan_match_o    ; // odd beats match (candidate = beat 1's slot)
    always_ff @ (posedge i_clk_mem) begin
        sel_used_q     <= sel_used;
        sel_odd_used_q <= sel_odd_used;
        rd_beats_q     <= rd_beats;
        scan_sel_q     <= scan_sel;
        scan_sel_q2    <= scan_sel_q;
        scan_sel_q3    <= scan_sel_q2;
        scan_valid_q   <= cal_eval;
        scan_valid_q2  <= scan_valid_q;
        scan_valid_q3  <= scan_valid_q2;
    end
    always_comb begin
        scan_match   = 1'b1;
        scan_match_o = 1'b1;
        for (int b = 0; b < 8; b++) begin
            if (rd_beats_q[b] != cal_beat(b[3:0])) begin
                if (b[0]) begin
                    scan_match_o = 1'b0;
                end else begin
                    scan_match = 1'b0;
                end
            end
        end
    end

    localparam logic [16-1:0] DQS_TOGGLE = 16'b11_11_00_00_11_11_00_00; // {U,L} per slot, slots 2,3,6,7 high

    always_ff @ (posedge i_clk_mem) begin
        if (i_rst_mem) begin
            state        <= State_RESET;
            timer        <= C_RESET;
            ref_cnt      <= 32'b0;
            ref_due      <= 1'b0;
            ref_total    <= 32'b0;
            recal_due    <= 1'b0;
            recal_active <= 1'b0;
            recal_count  <= 32'b0;
            recal_fail   <= 32'b0;
            sel_min      <= 6'h3F;
            sel_max      <= 6'h00;
            sel_odd_min  <= 6'h3F;
            sel_odd_max  <= 6'h00;
            req_s1       <= 1'b0;
            req_s2       <= 1'b0;
            req_s3       <= 1'b0;
            done_tog_m   <= 1'b0;
            init_done_m  <= 1'b0;
            cmd          <= CMD_DES;
            o_ba         <= 3'b0;
            o_a          <= 14'b0;
            o_reset_n    <= 1'b0;
            o_cke        <= 1'b0;
            wr_cnt       <= 3'b0;
            rd_cnt       <= 4'b0;
            rd_pend      <= 1'b0;
            cal_active   <= 1'b0;
            cal_we       <= 1'b0;
            cal_sel      <= RD_SEL_DEFAULT[5:0];
            cal_sel_odd  <= RD_SEL_DEFAULT[5:0] + 6'd2;
            cal_lat      <= RD_LAT_DEFAULT[3:0];
            cal_eval     <= 1'b0;
            scan_sel     <= 6'b0;
            scan_first   <= 6'b0;
            scan_last    <= 6'b0;
            scan_found   <= 1'b0;
            scan_first_o <= 6'b0;
            scan_last_o  <= 6'b0;
            scan_found_o <= 1'b0;
            scan_done    <= 1'b0;
            cal_ok_m     <= 1'b0;
            cal_fail_m   <= 1'b0;
            o_dq_out     <= 128'b0;
            o_dq_oe      <= 4'b0;
            o_dm_out     <= 16'hFFFF;
            o_dqs_out    <= 16'b0;
            o_dqs_oe     <= 4'b0;
            rsp_data     <= 128'b0;
            dbg_dqsl     <= 64'b0;
            dbg_dqsu     <= 64'b0;
            dbg_dq0      <= 64'b0;
            dbg_dq8      <= 64'b0;
        end else begin
            req_s1 <= req_tog;
            req_s2 <= req_s1;
            req_s3 <= req_s2;

            // Default: DESELECT, no command.
            cmd <= CMD_DES;

            // Refresh interval timer (starts counting once initialised).
            if (init_done_m) begin
                if (ref_cnt >= C_REFI - 1) begin
                    ref_cnt <= 32'b0;
                    ref_due <= 1'b1;
                end else begin
                    ref_cnt <= ref_cnt + 1;
                end
            end

            // ---- write pattern generator ----
            if (wr_cnt != 3'b0) begin
                wr_cnt <= wr_cnt + 1;
            end
            case (wr_cnt)
                3'd2: begin // visible at N+2: DQS preamble on slots 6,7
                    o_dqs_out <= 16'b0;
                    o_dqs_oe  <= 4'b1000;
                    o_dq_oe   <= 4'b0000;
                end
                3'd3: begin // N+3: beats 0..3
                    o_dqs_out <= DQS_TOGGLE;
                    o_dqs_oe  <= 4'b1111;
                    o_dq_out  <= data_slots(wr_beat[0], wr_beat[1], wr_beat[2], wr_beat[3], wr_beat[0]);
                    o_dm_out  <= mask_slots(wr_mask[0], wr_mask[1], wr_mask[2], wr_mask[3], 2'b11);
                    o_dq_oe   <= 4'b1111;
                end
                3'd4: begin // N+4: beats 4..7
                    o_dqs_out <= DQS_TOGGLE;
                    o_dqs_oe  <= 4'b1111;
                    o_dq_out  <= data_slots(wr_beat[4], wr_beat[5], wr_beat[6], wr_beat[7], wr_beat[3]);
                    o_dm_out  <= mask_slots(wr_mask[4], wr_mask[5], wr_mask[6], wr_mask[7], wr_mask[3]);
                    o_dq_oe   <= 4'b1111;
                end
                3'd5: begin // N+5: postamble on slots 0,1; last beat tail on slot 0
                    o_dqs_out <= 16'b0;
                    o_dqs_oe  <= 4'b0001;
                    o_dq_out  <= {112'b0, wr_beat[7]};
                    o_dm_out  <= {14'h3FFF, wr_mask[7]};
                    o_dq_oe   <= 4'b0001;
                end
                3'd6: begin
                    o_dqs_oe <= 4'b0000;
                    o_dq_oe  <= 4'b0000;
                    o_dm_out <= 16'hFFFF;
                    wr_cnt   <= 3'b0;
                end
                default: begin
                end
            endcase

            // ---- read capture ----
            if (rd_pend) begin
                if (rd_cnt == lat_used) begin
                    rd_pend <= 1'b0;
                    if (cal_active) begin
                        // Freeze the history and scan the candidates.
                        cal_eval     <= 1'b1;
                        scan_sel     <= 6'b0;
                        scan_found   <= 1'b0;
                        scan_found_o <= 1'b0;
                        scan_done    <= 1'b0;
                    end else begin
                        for (int b = 0; b < 8; b++) begin
                            rsp_data[b * 16+:16] <= rd_beats[b];
                        end
                    end
                    dbg_dqsl <= hist_dqs[0];
                    dbg_dqsu <= hist_dqs[1];
                    dbg_dq0  <= hist_dq[0];
                    dbg_dq8  <= hist_dq[8];
                end else begin
                    rd_cnt <= rd_cnt + 1;
                end
            end

            // ---- calibration scan (one RD_SEL candidate per cycle) ----
            if (cal_eval) begin
                if (scan_sel == 6'd49) begin // last candidate: 49 + 14 = 63
                    cal_eval <= 1'b0;
                end else begin
                    scan_sel <= scan_sel + 1;
                end
            end
            if (scan_valid_q3) begin
                if (scan_match) begin
                    if (!scan_found) begin
                        scan_first <= scan_sel_q3;
                    end
                    scan_found <= 1'b1;
                    scan_last  <= scan_sel_q3;
                end
                if (scan_match_o) begin
                    if (!scan_found_o) begin
                        scan_first_o <= scan_sel_q3;
                    end
                    scan_found_o <= 1'b1;
                    scan_last_o  <= scan_sel_q3;
                end
                if (scan_sel_q3 == 6'd49) begin
                    scan_done <= 1'b1;
                end
            end

            // ---- command FSM ----
            if (timer != 32'b0) begin
                timer <= timer - 1;
            end else begin
                case (state)
                    State_RESET: begin
                        o_reset_n <= 1'b1;
                        timer     <= C_CKE;
                        state     <= State_CKE;
                    end
                    State_CKE: begin
                        o_cke <= 1'b1;
                        timer <= C_XPR;
                        state <= State_XPR;
                    end
                    State_XPR: begin
                        cmd   <= CMD_MRS;
                        o_ba  <= 3'd2;
                        o_a   <= MR2;
                        timer <= C_MRD;
                        state <= State_MR3;
                    end
                    State_MR3: begin
                        cmd   <= CMD_MRS;
                        o_ba  <= 3'd3;
                        o_a   <= MR3;
                        timer <= C_MRD;
                        state <= State_MR1;
                    end
                    State_MR1: begin
                        cmd   <= CMD_MRS;
                        o_ba  <= 3'd1;
                        o_a   <= MR1;
                        timer <= C_MRD;
                        state <= State_MR0;
                    end
                    State_MR0: begin
                        cmd   <= CMD_MRS;
                        o_ba  <= 3'd0;
                        o_a   <= MR0;
                        timer <= C_MOD;
                        state <= State_ZQ;
                    end
                    State_ZQ: begin
                        cmd   <= CMD_ZQCL;
                        o_ba  <= 3'd0;
                        o_a   <= 14'h0400; // A10 = 1 -> ZQCL
                        timer <= C_ZQINIT;
                        state <= ((CAL_ENABLE) ? ( State_CAL_START ) : ( State_IDLE ));
                        // Address / data muxes switch to the scratch line
                        // during tZQinit so CAL_START's ACT already uses it.
                        cal_active <= CAL_ENABLE;
                        cal_we     <= CAL_ENABLE;
                        cal_lat    <= CAL_LAT_MIN[3:0];
                    end
                    State_CAL_START: begin
                        // Write the pattern line, then read it back.
                        cmd   <= CMD_ACT;
                        o_ba  <= bank;
                        o_a   <= row;
                        timer <= C_RCD - 1;
                        state <= State_RW;
                    end
                    State_IDLE: begin
                        init_done_m <= 1'b1;
                        if (ref_due) begin
                            cmd       <= CMD_REF;
                            ref_due   <= 1'b0;
                            timer     <= C_RFC;
                            ref_total <= ref_total + 1;
                            if (recal_en_m && ((ref_total + 1) & RECAL_MASK) == 32'b0) begin
                                recal_due <= 1'b1;
                            end
                        end else if (recal_due) begin
                            // Periodic re-calibration: same sequence as at
                            // init, from the current RD_LAT, result applied
                            // only if the scan matches.
                            recal_due    <= 1'b0;
                            recal_active <= 1'b1;
                            cal_active   <= 1'b1;
                            cal_we       <= 1'b1;
                            state        <= State_CAL_START;
                        end else if (pending) begin
                            cmd   <= CMD_ACT;
                            o_ba  <= bank;
                            o_a   <= row;
                            timer <= C_RCD - 1;
                            state <= State_RW;
                        end
                    end
                    State_RW: begin
                        o_ba <= bank;
                        o_a  <= {4'b0001, col}; // A10 = 1: auto precharge (A12 = A11 = 0)
                        if (we_used) begin
                            cmd    <= CMD_WR;
                            wr_cnt <= 3'd1;
                            timer  <= C_WR_BUSY;
                            state  <= State_WR_WAIT;
                        end else begin
                            cmd     <= CMD_RD;
                            rd_pend <= 1'b1;
                            rd_cnt  <= 4'd1;
                            timer   <= C_RD_BUSY;
                            state   <= State_RD_WAIT;
                        end
                    end
                    State_RD_WAIT: begin
                        if (cal_active) begin
                            if (scan_done) begin
                                scan_done <= 1'b0;
                                if (scan_found && scan_found_o) begin
                                    cal_sel     <= scan_sum[6:1];
                                    cal_sel_odd <= scan_sum_o[6:1];
                                    cal_ok_m    <= 1'b1;
                                    cal_active  <= 1'b0;
                                    state       <= State_IDLE;
                                    // drift bookkeeping
                                    if (scan_sum[6:1] < sel_min) begin
                                        sel_min <= scan_sum[6:1];
                                    end
                                    if (scan_sum[6:1] > sel_max) begin
                                        sel_max <= scan_sum[6:1];
                                    end
                                    if (scan_sum_o[6:1] < sel_odd_min) begin
                                        sel_odd_min <= scan_sum_o[6:1];
                                    end
                                    if (scan_sum_o[6:1] > sel_odd_max) begin
                                        sel_odd_max <= scan_sum_o[6:1];
                                    end
                                    if (recal_active) begin
                                        recal_active <= 1'b0;
                                        recal_count  <= recal_count + 1;
                                    end
                                end else if (recal_active) begin
                                    // keep the values in use
                                    recal_active <= 1'b0;
                                    recal_fail   <= recal_fail + 1;
                                    cal_active   <= 1'b0;
                                    state        <= State_IDLE;
                                end else if (cal_lat < CAL_LAT_MAX[3:0]) begin
                                    // No data in the window: look later.
                                    cal_lat <= cal_lat + 1;
                                    cmd     <= CMD_ACT;
                                    o_ba    <= bank;
                                    o_a     <= row;
                                    timer   <= C_RCD - 1;
                                    state   <= State_RW;
                                end else begin
                                    cal_sel     <= RD_SEL_DEFAULT[5:0];
                                    cal_sel_odd <= RD_SEL_DEFAULT[5:0] + 6'd2;
                                    cal_lat     <= RD_LAT_DEFAULT[3:0];
                                    cal_fail_m  <= 1'b1;
                                    cal_active  <= 1'b0;
                                    state       <= State_IDLE;
                                end
                            end
                        end else if (!rd_pend) begin
                            done_tog_m <= ~done_tog_m;
                            state      <= State_IDLE;
                        end
                    end
                    State_WR_WAIT: begin
                        if (cal_active) begin
                            // Extra gap so the write echo is out of the
                            // history before the calibration read.
                            cal_we <= 1'b0;
                            cmd    <= CMD_ACT;
                            o_ba   <= bank;
                            o_a    <= row;
                            timer  <= C_RCD - 1 + 8;
                            state  <= State_RW;
                        end else begin
                            done_tog_m <= ~done_tog_m;
                            state      <= State_IDLE;
                        end
                    end
                    default: begin
                        state <= State_IDLE;
                    end
                endcase
            end
        end
    end

endmodule
//# sourceMappingURL=ddr3_ctrl.sv.map
