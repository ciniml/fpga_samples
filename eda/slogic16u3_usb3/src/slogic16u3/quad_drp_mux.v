// SPDX-License-Identifier: BSL-1.0
// Copyright Kenta Ida 2026.
// NOARB=1: the register port (upar) of the GW5AT-15 SerDes quad, shared between our PHY (channel p, as
// the upar arbiter's channel 0 had it) and requests from another clock domain (channel x: the host's
// quad register access through the vendor requests, top.v). One access at a time, the PHY first; an
// access is a write (wren held until ready) or a read (rden held until rdvld, data with it), as the
// quad does it (TAP=1 TAP_UPAR=1). project.tcl puts this in place of the arbiter and brings channel x
// out on SerDes_Top (XDRP_i / XDRP_o).
//
// Channel x: x_req toggles with x_wr / x_addr / x_wdata stable; x_done toggles when the access is done,
// with x_rdata (reads) stable from then on.
//
// QUAD_CSR_INIT (QCSR=1 builds): first, before either channel, the writes of quad_csr_rom.vh (generated by
// csr/gw5at15_csr.py: the static configuration that otherwise comes from the CSR file) go out once, a
// short while after the register clock starts; init_done tells when they are through.
module quad_drp_mux (
    input  wire        clk,     // the quad's register clock (q0_fabric_cm_life_clk_o)
    input  wire        p_wren,
    input  wire        p_rden,
    input  wire [23:0] p_addr,
    input  wire [31:0] p_wrdata,
    input  wire [7:0]  p_strb,
    output wire        p_ready,
    output wire        p_rdvld,
    output wire [31:0] p_rddata,
    input  wire        x_req,   // asynchronous toggle
    input  wire        x_wr,
    input  wire [23:0] x_addr,
    input  wire [31:0] x_wdata,
    output reg         x_done = 1'b0,
    output reg  [31:0] x_rdata = 32'd0,
    output wire        init_done,
    output wire        wren,
    output wire        rden,
    output wire [23:0] addr,
    output wire [31:0] wrdata,
    output wire [7:0]  strb,
    input  wire        ready,
    input  wire        rdvld,
    input  wire [31:0] rddata
);
    reg [2:0] req_s = 3'd0;
    reg       ack = 1'b0;      // last request toggle taken
    reg       xbusy = 1'b0;    // channel x owns the port
    reg       xwr = 1'b0, xrd = 1'b0;
    reg       pbusy = 1'b0;    // a PHY access is on the port
    wire      x_pend = req_s[2] != ack;

`ifdef QUAD_CSR_INIT
`include "quad_csr_rom.vh"
    reg [10:0] iwait = 11'd0;  // ~37 us at the ~56 MHz register clock before the first write
    reg [8:0]  ii = 9'd0;
    reg        iw = 1'b0, idone = 1'b0;
    wire [55:0] irom = qcsr_rom(ii);
    always @(posedge clk) begin
        if (!idone) begin
            if (!iwait[10]) iwait <= iwait + 11'd1;
            else if (!iw) iw <= 1'b1;
            else if (ready) begin
                iw <= 1'b0;
                ii <= ii + 9'd1;
                if (ii == QCSR_N - 1) idone <= 1'b1;
            end
        end
    end
    wire        ibusy = !idone;
`else
    wire        ibusy = 1'b0, iw = 1'b0;
    wire [55:0] irom = 56'd0;
`endif
    assign init_done = !ibusy;

    always @(posedge clk) begin
        req_s <= {req_s[1:0], x_req};
        if (ibusy) begin
            // configuration writes first
        end else if (xbusy) begin
            if (xwr && ready) begin
                xwr <= 1'b0; xbusy <= 1'b0; x_done <= !x_done;
            end else if (xrd && rdvld) begin
                xrd <= 1'b0; xbusy <= 1'b0; x_rdata <= rddata; x_done <= !x_done;
            end
        end else if (pbusy || p_wren || p_rden) begin
            // the PHY's access runs until its ready / rdvld (it drops the request the clock after)
            pbusy <= !((p_wren && ready) || (p_rden && rdvld));
        end else if (x_pend) begin
            ack <= req_s[2]; xbusy <= 1'b1; xwr <= x_wr; xrd <= !x_wr;
        end
    end

    assign wren    = ibusy ? iw : xbusy ? xwr : p_wren;
    assign rden    = ibusy ? 1'b0 : xbusy ? xrd : p_rden;
    assign addr    = ibusy ? irom[55:32] : xbusy ? x_addr : p_addr;
    assign wrdata  = ibusy ? irom[31:0] : xbusy ? x_wdata : p_wrdata;
    assign strb    = ibusy || xbusy ? 8'hFF : p_strb;
    assign p_ready = !ibusy && !xbusy && ready;
    assign p_rdvld = !ibusy && !xbusy && rdvld;
    assign p_rddata = rddata;
endmodule
